#include <WiFi.h>
#include <WiFiClientSecure.h>

#include <ArduinoJson.h> 
#include <GxEPD2_BW.h>
#include <GxEPD2_3C.h>
#include <Fonts/FreeSansBold18pt7b.h>


char wifiSSID[] = "Your wifi details";
char wifiPASS[] = "password";

GxEPD2_BW<GxEPD2_154, GxEPD2_154::HEIGHT> display(GxEPD2_154(/*CS=5*/ SS, /*DC=*/ 22, /*RST=*/ 21, /*BUSY=*/ 4));

const char* host = "api.opennode.co";
const int httpsPort = 443;
String on_currency = "BTCGBP";
String price;

const unsigned char logo [] PROGMEM = {
  // 'BC_Logo_, 200x42px
  0xff, 0xff, 0xff, 0xff, 0xff, 0xff, 0xff, 0xff, 0xff, 0xff, 0xff, 0xff, 0xff, 0xff, 0xff, 0xff, 
  0xff, 0xff, 0xff, 0xff, 0xff, 0xff, 0xff, 0xff, 0xff, 0xff, 0xff, 0xff, 0xff, 0xff, 0xff, 0xff, 
  0xff, 0xff, 0xff, 0xff, 0xff, 0xff, 0xff, 0xff, 0xff, 0xff, 0xff, 0xff, 0xff, 0xff, 0xff, 0xff, 
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  0xff, 0xff, 0xff, 0xff, 0xff, 0xff, 0xff, 0xff, 0xff, 0xff
};



void setup() {
  


Serial.begin(115200); 
           
  WiFi.begin(wifiSSID, wifiPASS);   
  while (WiFi.status() != WL_CONNECTED) {
     Serial.println("connecting");
     delay(500);
     }
     
  Serial.println("connected");


display.init(115200);
 display.setRotation(4);
  display.setFont(&FreeSansBold18pt7b);
  display.setTextColor(GxEPD_BLACK);
  
  ONprice();
  
  display.firstPage();
  do
  {
    display.fillScreen(GxEPD_WHITE);
     display.drawInvertedBitmap(0, 50, logo, 200, 42, GxEPD_BLACK);
    display.setCursor(0, 120);
   
    display.print("GBP" + price);
  }
  while (display.nextPage());
}


void loop() {

  
      esp_sleep_enable_timer_wakeup(2 * 3600000000);     
      esp_deep_sleep_start();
  
  }

void ONprice(){
  WiFiClientSecure client;

  if (!client.connect(host, httpsPort)) {

    return;
  }



  String url = "/v1/rates";


  client.print(String("GET ") + url + " HTTP/1.1\r\n" +
               "Host: " + host + "\r\n" +
               "User-Agent: ESP32\r\n" +
               "Connection: close\r\n\r\n");

  while (client.connected()) {

     String line = client.readStringUntil('\n');
    if (line == "\r") {

      break;
    }
  }
  String line = client.readStringUntil('\n');
 
const size_t capacity = 169*JSON_OBJECT_SIZE(1) + JSON_OBJECT_SIZE(168) + 3800;

DynamicJsonBuffer jsonBuffer(capacity);

JsonObject& root = jsonBuffer.parseObject(line);

JsonObject& data = root["data"];

String temp = data[on_currency][on_currency.substring(3)]; 
price = temp;
Serial.println(price);

}
